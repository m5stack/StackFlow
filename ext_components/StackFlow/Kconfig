## ext_components/StackFlow/Kconfig
```kconfig
menuconfig STACKFLOW_ENABLED
    bool "Enable stackflow"
    default n
    help
        Enable Axera stackflow support

menuconfig RASPBERRYPI_ENV
    bool "Enable Raspberry Pi environment"
    default n
    help
        Choose which Raspberry Pi OS environment to use.

if RASPBERRYPI_ENV

choice
    prompt "Raspberry Pi environment version"
    default RPI_ENV_BOOKWORM
    help
        Select the Raspberry Pi OS environment version.

config RPI_ENV_BOOKWORM
    bool "Bookworm"

config RPI_ENV_TRIXIE
    bool "Trixie"

endchoice

endif
```

## ext_components/ax_msp/Kconfig
```kconfig
menuconfig AX_MSP_ENABLED
    bool "Enable ax_msp support"
    default n
    help
        enable axera bsp support

    choice
        prompt "choice board"
        default AX_620E_MSP_ENABLED
        depends on AX_MSP_ENABLED
    config AX_620E_MSP_ENABLED
        bool "enable ax620e bsp"
        help
            build by AXERA!
    config AX_650N_MSP_ENABLED
        bool "enable ax650n bsp"
        help
            build by AXERA!
    config AX_520_MSP_ENABLED
        bool "enable ax520 bsp"
        help
            build by AXERA!
    endchoice

    choice
        prompt "choice common version"
        default MSP_V2_0_0_ENABLED
        depends on AX_MSP_ENABLED
    config MSP_V3_0_0_ENABLED
        bool "enable v3.0.0 bsp"
        help
            build by m5stack!
    config MSP_V2_0_0_ENABLED
        bool "enable v2.0.0 bsp"
        help
            build by m5stack!
    endchoice
    
    config SAMPLE_COMMON_ENABLED
        bool "Enable sample common"
        default n
        depends on AX_MSP_ENABLED
        help
            enable sample common
```

## ext_components/axcl/Kconfig
```kconfig
menuconfig AXCL_ENABLED
    bool "Enable axera axcl support"
    default n
    help
        Enable axera axcl support.

if AXCL_ENABLED

config AXCL_RUNTIME_API_ENABLE
    bool "Enable AXCL runtime API"
    default y
    help
        Enable AXCL runtime API support.
        This option is only available if AXCL is enabled.

config AXCL_NATIVE_API_ENABLE
    bool "Enable AXCL native API"
    default y
    help
        Enable AXCL native API support.
        This option is only available if AXCL is enabled.

config AXCL_HAS_STD_FILESYSTEM
    bool "Enable std::filesystem support in AXCL"
    default y
    help
        Enable std::filesystem support in AXCL.
        This option is only available if AXCL is enabled.

config AXCL_HAS_POSIX_FILE_STAT
    bool "Enable POSIX file stat support in AXCL"
    default y
    help
        Enable POSIX file stat (e.g., struct stat) support in AXCL.
        This option is only available if AXCL is enabled.

endif # AXCL_ENABLED
```

## ext_components/tokenizer/Kconfig
```kconfig
menuconfig AX_TOKENIZER_ENABLED
    bool "Enable tokenizer support"
    default n
    help
        enable tokenizer support
```
