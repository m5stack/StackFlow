## ext_components/SimpleCV/Kconfig
```kconfig
menuconfig AX_SIMPLECV_ENABLED
    bool "Enable SimpleCV support"
    default n
    help
        enable SimpleCV support
```

## ext_components/eigen/Kconfig
```kconfig
menuconfig EIGEN_ENABLED
    bool "Enable eigen support"
    default n
    help
        enable eigen support
```

## ext_components/kaldi-decoder/Kconfig
```kconfig
menuconfig KALDI_DECODER_ENABLED
    bool "Enable kaldi-decoder support"
    default n
    help
        enable kaldi-decoder support
```

## ext_components/kaldifst/Kconfig
```kconfig
menuconfig KALDIFST_ENABLED
    bool "Enable kaldifst support"
    default n
    help
        enable kaldifst support
```

## ext_components/openai-api/Kconfig
```kconfig
menuconfig AX_OPENAI_API_ENABLED
    bool "Enable openai-api support"
    default n
    help
        enable openai-api support
```

## ext_components/sherpa-ncnn/Kconfig
```kconfig
menuconfig SHERPA_NCNN_ENABLED
    bool "Enable sherpa-ncnn support"
    default n
    help
        enable sherpa-ncnn support
```

## ext_components/sherpa-onnx/Kconfig
```kconfig
menuconfig SHERPA_ONNX_ENABLED
    bool "Enable sherpa-onnx support"
    default n
    help
        enable sherpa-onnx support
```
